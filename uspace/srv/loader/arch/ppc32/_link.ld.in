/*
 * The only difference from _link.ld.in for regular statically-linked apps
 * is the base address.
 */

STARTUP(LIBC_PREFIX/arch/UARCH/src/entry.o)
ENTRY(__entry)

PHDRS {
	interp PT_INTERP;
	text PT_LOAD FLAGS(5);
	data PT_LOAD FLAGS(6);
}

SECTIONS {
	.interp : {
		*(.interp);
	} :interp
	
	. = 0x70001000 + SIZEOF_HEADERS;
	
	.init : {
		*(.init);
	} :text
	
	.text : {
		*(.text .text.*);
		*(.rodata .rodata.*);
	} :text
	
	. = . + 0x1000;
	
	.data : {
		*(.data);
		*(.sdata);
	} :data
	
	.tdata : {
		_tdata_start = .;
		*(.tdata);
		_tdata_end = .;
		_tbss_start = .;
		*(.tbss);
		_tbss_end = .;
	} :data
	
	_tls_alignment = ALIGNOF(.tdata);
	
	.bss : {
		*(.sbss);
		*(COMMON);
		*(.bss);
	} :data
	
	/DISCARD/ : {
		*(*);
	}
}
