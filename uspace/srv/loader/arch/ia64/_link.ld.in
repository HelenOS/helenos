STARTUP(LIBC_PREFIX/arch/ARCH/src/entry.o)
ENTRY(__entry)

PHDRS {
	interp PT_INTERP;
	text PT_LOAD FLAGS(5);
	data PT_LOAD FLAGS(6);
}

SECTIONS {
	.interp : {
		*(.interp);
	} :interp

	/* On Itanium code sections must be aligned to 16 bytes. */
	. = ALIGN(0x800000000 + SIZEOF_HEADERS, 16);

	.init : {
		*(.init);
	} : text
	.text : {
		*(.text);
		*(.rodata*);
	} :text

	. = . + 0x4000;

	.got : {
		_gp = .;
		*(.got*);
	} :data	
	.data : {
		*(.opd);
		*(.data .data.*);
		*(.sdata);
	} :data
	.tdata : {
		_tdata_start = .;
		*(.tdata);
		_tdata_end = .;
	} :data
	.tbss : {
		_tbss_start = .;
		*(.tbss);
		_tbss_end = .;
	} :data
	_tls_alignment = MAX(ALIGNOF(.tdata), ALIGNOF(.tbss));
	.bss : {
		*(.sbss);
		*(.scommon);
		*(COMMON);
		*(.bss);
	} :data

	. = ALIGN(0x4000);
	_heap = .;
 
	/DISCARD/ : {
		*(*);
        }
}
