STARTUP(LIBC_PATH/arch/UARCH/src/entry.o)
ENTRY(__entry)

PHDRS {
	text PT_LOAD FILEHDR PHDRS FLAGS(5);
	data PT_LOAD FLAGS(6);
	tls PT_TLS;
}

SECTIONS {
	. = SEGMENT_START("text-segment", 0x400000);
#ifndef SHLIB
	PROVIDE (__executable_start = .);
#endif
	. = . + SIZEOF_HEADERS;

	.init : {
		*(.init);
	} :text

	.text : {
		*(.text .text.*);
		*(.rodata .rodata.*);
	} :text

	. = . + 0x1000;

	.data : {
		*(.opd);
		*(.data .data.*);
		*(.sdata);
	} :data

	.tdata : {
		*(.tdata);
		*(.tdata.*);
		*(.gnu.linkonce.td.*);
	} :data :tls

	.tbss : {
		*(.tbss);
		*(.tbss.*);
		*(.gnu.linkonce.tb.*);
	} :data :tls

	.bss : {
		*(.sbss);
		*(.scommon);
		*(COMMON);
		*(.bss);
	} :data

	_end = .;

	/DISCARD/ : {
		*(*);
	}
}
