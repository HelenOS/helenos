STARTUP(../../lib/libc/arch/ARCH/src/entry.o)
ENTRY(__entry)

PHDRS {
	text PT_LOAD FLAGS(5);
	data PT_LOAD FLAGS(6);
}

SECTIONS {
	. = 0x4000;

	.init ALIGN(0x4000) : SUBALIGN(0x4000) {
		*(.init);
	} :text
	.text : {
		*(.text);
		*(.rodata*);
	} :text
	
	.got ALIGN(0x4000) : SUBALIGN(0x4000) {
		 _gp = .;
		 *(.got*);
	} :data
	.data ALIGN(0x4000) : SUBALIGN(0x4000) {
		*(.data);
		*(.sdata);
	} :data
	.tdata : {
		_tdata_start = .;
		*(.tdata);
		_tdata_end = .;
	} :data
	.tbss : {
		_tbss_start = .;
		*(.tbss);
		_tbss_end = .;
	} :data
	.bss : {
		*(.sbss);
		*(COMMON);
		*(.bss);
	} :data

	. = ALIGN(0x4000);
	_heap = .;
	
	/DISCARD/ : {
		*(*);
	}

}
