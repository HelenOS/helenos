STARTUP(LIBC_PREFIX/arch/UARCH/src/entry.o)
ENTRY(__entry)

PHDRS {
	text PT_LOAD FLAGS(5);
	data PT_LOAD FLAGS(6);
}

SECTIONS {
	. = 0x4000 + SIZEOF_HEADERS;

	.init : {
		*(.init);
	} : text
	.text : {
		*(.text);
		*(.rodata*);
	} :text

	. = . + 0x4000;

	.got : {
		_gp = .;
		*(.got*);
	} :data	
	.data : {
		*(.opd);
		*(.data .data.*);
		*(.sdata);
	} :data
	.tdata : {
		_tdata_start = .;
		*(.tdata);
		_tdata_end = .;
		_tbss_start = .;
		*(.tbss);
		_tbss_end = .;
	} :data
	_tls_alignment = ALIGNOF(.tdata);
	.bss : {
		*(.sbss);
		*(.scommon);
		*(COMMON);
		*(.bss);
	} :data

	. = ALIGN(0x4000);
	_heap = .;
 
	/DISCARD/ : {
		*(*);
        }
}
