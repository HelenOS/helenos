STARTUP(../../lib/libc/arch/ARCH/src/entry.o)
ENTRY(__entry)

PHDRS {
	text PT_LOAD FLAGS(5);
	data PT_LOAD FLAGS(6);
}

SECTIONS {
	. = 0x1000;

	.init ALIGN(0x1000) : SUBALIGN(0x1000) {
		*(.init);
	} :text
	.text : {
		*(.text);
		*(.toc);
		*(.rodata*);
	} :text
	
	.data ALIGN(0x1000) : SUBALIGN(0x1000) {
		*(.opd);
		*(.data*);
		*(.sdata);
	} :data
	.tdata : {
		_tdata_start = .;
		*(.tdata);
		_tdata_end = .;
	} :data
	.tbss : {
		_tbss_start = .;
		*(.tbss);
		_tbss_end = .;
	} :data
	.bss : {
		*(.sbss);
		*(COMMON);
		*(.bss);
	} :data

	. = ALIGN(0x1000);
	_heap = .;
	
	/DISCARD/ : {
		*(*);
	}

}
