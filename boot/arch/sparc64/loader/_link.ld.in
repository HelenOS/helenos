OUTPUT_FORMAT("elf64-sparc")
ENTRY(start)

SECTIONS {
	.boot 0x4000: AT (0x4000) {
		*(BOOTSTRAP);
		*(.text);
		*(.rodata);
		*(.rodata.*);
		*(.data);               /* initialized data */
		*(.sdata);
		*(.sdata2);
		*(.sbss);
		*(.bss);                /* uninitialized static variables */
		*(COMMON);
[[COMPONENTS]]
	}
	
	/DISCARD/ : {
		*(.comment);
		*(.note*);
	}
}
