#include <arch/arch.h>

ENTRY(start)

SECTIONS {
	. = PHYSMEM_START;

	.text : {
		loader_start = .;
		KEEP(*(BOOTSTRAP));
		*(.text .text.*);
	}

	. = ALIGN(0x1000);
	.htif : {
		htif_page = .;
		*(.htif)
	}
	. = ALIGN(0x1000);

	. = ALIGN(0x1000);
	.pt : {
		pt_page = .;
		*(.pt)
	}
	. = ALIGN(0x1000);

	.data : {
		*(.data .data.*);       /* initialized data */
		*(.rodata .rodata.*);
		*(.sdata .sdata.*);
		*(.sbss .sbss.*);
		*(.scommon .scommon.*);
		*(.bss .bss.*);        /* uninitialized static variables */
		*(COMMON);      /* global variables */
		loader_end = .;
		payload_start = .;
		KEEP(*(.payload));
		payload_end = .;
	}

	/DISCARD/ : {
		*(.gnu.*);
		*(.mdebug*);
		*(.pdr);
		*(.comment);
		*(.note);
	}
}
