ENTRY(start)

SECTIONS {
	. = 0x08000000;
	.text : {
		loader_start = .;
		KEEP(*(BOOTSTRAP));
		*(.text .text.*);
	}
	.data : {
		*(.data .data.*);       /* initialized data */
		*(.rodata .rodata.*);
		*(.sdata .sdata.*);
		*(.sbss .sbss.*);
		*(.scommon .scommon.*);
		*(.bss .bss.*);        /* uninitialized static variables */
		*(COMMON);      /* global variables */
		loader_end = .;
		payload_start = .;
		KEEP(*(.payload));
		payload_end = .;
	}

	/DISCARD/ : {
		*(.gnu.*);
		*(.mdebug*);
		*(.pdr);
		*(.comment);
		*(.note.*);
	}
}
