OUTPUT_FORMAT("elf64-ia64-little")
ENTRY(start)

SECTIONS {
	.boot 0x4400000: AT (0x4400000) {
		loader_start = .;
		KEEP(*(BOOTSTRAP));
		*(.text .text.*);
		*(.sdata .sdata.*);
		*(.sdata2 .sdata2.*);
		*(.sbss .sbss.*);
		*(.rodata .rodata.*);
		*(.data .data.*);       /* initialized data */
		__gp = . ;
		*(.got .got.*);
		*(.bss .bss.*);                /* uninitialized static variables */
		*(COMMON);
		loader_end = .;
		payload_start = .;
		KEEP(*(.payload));
		payload_end = .;
	}

	/DISCARD/ : {
		*(.*);
	}
}
