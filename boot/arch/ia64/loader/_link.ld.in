OUTPUT_FORMAT("elf64-ia64-little")
ENTRY(start)

SECTIONS {
	.boot 0x4400000: AT (0x4400000) {
		*(BOOTSTRAP);
[[COMPONENTS]]		
		. = ALIGN (16384);
		*(.text);
		*(.rodata);
		*(.rodata.*);
		*(.data);               /* initialized data */
		_got = . ;
		*(.got .got.*);               
		*(.bss);                /* uninitialized static variables */
		*(COMMON);
	}

	.sboot : {
		*(.sdata);
		*(.sdata2);
		*(.sbss);
	}
	
	/DISCARD/ : {
		*(.comment);
		*(.note*);
	}
}
