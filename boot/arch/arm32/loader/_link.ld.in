OUTPUT_FORMAT("elf32-littlearm")
ENTRY(start)

SECTIONS {
	.boot 0x0: AT (0) {
		*(BOOTSTRAP);
		*(.text);
		
		*(.rodata);
		*(.rodata.*);
		*(.data);		/* initialized data */
		*(.sdata);
		*(.sdata2);
		*(.sbss);
		*(.scommon);
		*(.bss);		/* uninitialized static variables */	
		*(COMMON); 		/* global variables */
		*(.reginfo);

		. = 0x2000;
		*(ST);			/* bootloader stack section */

		. = 0x4000;
		*(PT);			/* page table placed at 0x4000 */
[[COMPONENTS]]
	}
}
