STARTUP(../libc/arch/ARCH/src/entry.o)
ENTRY(__entry)

PHDRS {
	text PT_LOAD FLAGS(5);
	data PT_LOAD FLAGS(6);
}

SECTIONS {
	. = 0x4000;

	.init ALIGN(0x4000): SUBALIGN(0x4000) {
		*(.init);
	} : text
	.text : {
		*(.text);
		*(.rodata*);
	} :text

	.got ALIGN(0x4000) : SUBALIGN(0x4000) {
		_gp = .;
		*(.got*);
	} :data	
	.data : {
		*(.opd);
		*(.data);
		*(.sdata);
	} :data
	.bss : {
		*(.sbss);
		*(.scommon);
		*(COMMON);
		*(.bss);
		_heap = .;
		QUAD(0xdeadbeef);
	} :data
 
	/DISCARD/ : {
		*(*);
        }
}
