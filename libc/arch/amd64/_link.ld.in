STARTUP(../libc/arch/ARCH/src/entry.o)
ENTRY(__entry)

PHDRS {
	text PT_LOAD FLAGS(5);
	data PT_LOAD FLAGS(6);
}

SECTIONS {
	. = 0x1000;
	
	.init ALIGN(0x1000) : SUBALIGN(0x1000) {
		*(.init);
	} :text
	.text : {
		*(.text);
		*(.rodata*);
	} :text
	
	.data ALIGN(0x1000) : SUBALIGN(0x1000) {
		*(.data);
	} :data
	.bss : {
		*(COMMON);
		*(.bss);
		_heap = .;
		QUAD(0xdeadbeef);
	} :data

	/DISCARD/ : {
		*(*);
	}

}
