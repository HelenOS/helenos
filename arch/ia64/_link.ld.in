/** IA-64 linker script
 *
 *  It is ELF format, but its only section looks like this:
 *  kernel text
 *  kernel data
 *
 */

#define __ASM__

ENTRY(kernel_image_start)

SECTIONS {
	.image 0xe000000000100000: AT (0x0000000000100000) { 
		ktext_start = .;
		*(K_TEXT_START);
		*(.text)
		ktext_end = .;
		
		kdata_start = .;
		*(K_DATA_START)
		*(.rodata .rodata.*)
		*(.opd)
		*(.data)
		*(.got .got.*)
		*(.sdata)
		*(.sbss)
		*(.scommon)
		*(.bss)
		*(COMMON);

                symbol_table = .;
                *(symtab.*);            /* Symbol table, must be LAST symbol!*/

		kdata_end = .;
	}

	_hardcoded_ktext_size = ktext_end - ktext_start;
	_hardcoded_kdata_size = kdata_end - kdata_start;
	_hardcoded_load_address = 0xe000000000100000;

}
