/** PPC32 linker script
 *
 *  It is ELF format, but its only section looks like this:
 *  kernel text
 *  kernel data
 *
 */

#define __ASM__
#include <arch/boot/boot.h>
#include <arch/mm/page.h>

ENTRY(kernel_image_start)

SECTIONS {
	.image PA2KA(BOOT_OFFSET): AT (0) { 
		ktext_start = .;
		*(K_TEXT_START)
		*(.text);
		ktext_end = .;
		
		kdata_start = .;
		*(K_DATA_START)
		*(.rodata);
		*(.rodata.*);
		*(.data);		/* initialized data */
		*(.sdata);
		*(.sdata2);
		*(.sbss);
		hardcoded_ktext_size = .;
		LONG(ktext_end - ktext_start);	
		hardcoded_kdata_size = .;
		LONG(kdata_end - kdata_start);
		hardcoded_load_address = .;
		LONG(PA2KA(BOOT_OFFSET));
		*(.bss);		/* uninitialized static variables */	
		*(COMMON); 		/* global variables */

		symbol_table = .;
		*(symtab.*);            /* Symbol table, must be LAST symbol!*/

		kdata_end = .;
	}
}
