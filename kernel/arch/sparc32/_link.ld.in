#define KERNEL_LOAD_ADDRESS  0x80a00000

ENTRY(kernel_image_start)

SECTIONS {
	. = KERNEL_LOAD_ADDRESS;
	
	.text : {
		ktext_start = .;
		*(.text);
		ktext_end = .;
	}
	
	.data : {
		kdata_start = .;
		*(.data);                       /* initialized data */
		. = ALIGN(8);
		hardcoded_ktext_size = .;
		LONG(ktext_end - ktext_start);
		hardcoded_kdata_size = .;
		LONG(kdata_end - kdata_start);
		hardcoded_load_address = .;
		LONG(KERNEL_LOAD_ADDRESS);
		*(.bss);                        /* uninitialized static variables */
		*(COMMON);                      /* global variables */
		
		*(.rodata*);
		*(.sdata);
		*(.reginfo);
		. = ALIGN(8);
		symbol_table = .;
		*(symtab.*);
	}
	
	.sbss : {
		*(.sbss);
		*(.scommon);
	}
	
	kdata_end = .;
	
	/DISCARD/ : {
		*(.mdebug*);
		*(.pdr);
		*(.comment);
		*(.note);
	}
}
