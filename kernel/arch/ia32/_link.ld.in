/** IA-32 linker script
 *
 * umapped section:
 *  kernel text
 *  kernel data
 * mapped section:
 *  kernel text
 *  kernel data
 */

#include <arch/boot/boot.h>
#include <arch/mm/page.h>

ENTRY(multiboot_image_start)

PHDRS {
	ap_boot PT_LOAD ;
	unmapped PT_LOAD ;
	mapped PT_LOAD ;
}

SECTIONS {
	kernel_load_address = PA2KA(BOOT_OFFSET);

	.ap_bootstrap (AP_BOOT_OFFSET): AT (AP_BOOT_OFFSET) {
		ap_bootstrap_start = .;

		/* Must be first. */
		*(.multiboot);

		*(K_AP_TEXT_START);
		*(K_AP_DATA_START);
		ap_bootstrap_end = .;
	} :ap_boot

	.unmapped (BOOT_OFFSET): AT (BOOT_OFFSET) {
		unmapped_start = .;
		*(K_TEXT_START);
		*(K_DATA_START);
		unmapped_end = .;
	} :unmapped

	.unmapped_bss : {
		*(.bootstack);
	} :unmapped

	.mapped (PA2KA(BOOT_OFFSET) + SIZEOF(.unmapped) + SIZEOF(.unmapped_bss)): AT (BOOT_OFFSET + SIZEOF(.unmapped) + SIZEOF(.unmapped_bss)) {
		ktext_start = .;
		*(.text .text.*);
		ktext_end = .;

		kdata_start = .;
		*(.data);               /* initialized data */
		*(.rodata .rodata.*);   /* string literals */
		*(COMMON);              /* global variables */

		/* bss can't be omitted from the ELF image. */
		*(.bss);                /* uninitialized static variables */

		. = ALIGN(8);
		symbol_table = .;
		*(symtab.*);            /* Symbol table, must be LAST symbol! */
		kdata_end = .;
	} :mapped

#ifdef CONFIG_LINE_DEBUG
	.comment 0 : { *(.comment); }
	.debug_abbrev 0 : { *(.debug_abbrev); }
	.debug_aranges 0 : { *(.debug_aranges); }
	.debug_info 0 : { *(.debug_info); }
	.debug_line 0 : { *(.debug_line); }
	.debug_loc 0 : { *(.debug_loc); }
	.debug_pubnames 0 : { *(.debug_pubnames); }
	.debug_pubtypes 0 : { *(.debug_pubtypes); }
	.debug_ranges 0 : { *(.debug_ranges); }
	.debug_str 0 : { *(.debug_str); }
#endif

	/DISCARD/ : {
		*(*);
	}

#ifdef CONFIG_SMP
	protected_ap_gdtr = PA2KA(ap_gdtr);
#endif /* CONFIG_SMP */

}
