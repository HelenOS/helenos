SECTIONS {
	.text : {
		kernel_load_address = .;
		ktext_start = .;
		*(.text);
		ktext_end = .;
	}
	.data : {
		kdata_start = .;
		*(.data);                       /* initialized data */
		*(.bss);                        /* uninitialized static variables */
		*(COMMON);                      /* global variables */

		*(.rodata*);
		*(.sdata);
		*(.reginfo);
		. = ALIGN(8);
		symbol_table = .;
		*(symtab.*);
	}
	.sbss : {
		*(.sbss);
		*(.scommon);
	}

	kdata_end = .;

	/DISCARD/ : {
		*(.mdebug*);
		*(.pdr);
		*(.comment);
		*(.note);
	}
}
