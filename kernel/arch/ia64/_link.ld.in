/** IA-64 linker script
 *
 *  It is ELF format, but its only section looks like this:
 *  kernel text
 *  kernel data
 *
 */

#define LOAD_ADDRESS_V	0xe000000004800000
#define LOAD_ADDRESS_P	0x0000000004800000

ENTRY(kernel_image_start)

SECTIONS {
	kernel_load_address = LOAD_ADDRESS_V;

	.image (LOAD_ADDRESS_V + SIZEOF_HEADERS): AT (LOAD_ADDRESS_P + SIZEOF_HEADERS) {
		. = ALIGN(16);
		ktext_start = .;
		*(K_TEXT_START);
		*(.text .text.*)
		ktext_end = .;

		kdata_start = .;
		*(K_DATA_START)
		*(.rodata .rodata.*)
		*(.opd)
		*(.data .data.*)
		__gp = .;
		*(.got .got.*)
		*(.sdata)
		*(.sbss)
		*(.scommon)
		*(.bss)
		*(COMMON);

		. = ALIGN(8);
		symbol_table = .;
		*(symtab.*);            /* Symbol table, must be LAST symbol!*/

		kdata_end = .;
	}

	/DISCARD/ : {
		*(*);
	}
}
